## conf/layer.conf
```bitbake
# conf and classes directory
BBPATH .= ":${LAYERDIR}"

# recipes directory
BBFILES += "${LAYERDIR}/recipes-*/*/*.bb ${LAYERDIR}/recipes-*/*/*.bbappend"
BBFILE_COLLECTIONS += "apro-layer"
BBFILE_PATTERN_apro-layer := "^${LAYERDIR}/"

# Define the priority for recipes (.bb files) from this layer,
# choosing carefully how this layer interacts with all of the
# other layers.
BBFILE_PRIORITY_apro-layer = "6"
```
